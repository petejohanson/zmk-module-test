## boards/shields/xiao_solo/Kconfig.shield
```kconfig
# Copyright (c) 2020 Pete Johanson
# SPDX-License-Identifier: MIT

config SHIELD_XIAO_SOLO
	def_bool $(shields_list_contains,xiao_solo)
```

## build/west.yml
```yaml
manifest:
  remotes:
    - name: zmkfirmware
      url-base: https://github.com/zmkfirmware
    - name: petejohanson
      url-base: https://github.com/petejohanson
  projects:
    - name: zmk
      remote: petejohanson
      revision: core/modular-boards-shields-extensions
      import: app/west.yml
  self:
    path: build
```
